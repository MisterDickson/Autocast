#include <fcntl.h>
#include <unistd.h>
#include <sys/ioctl.h>
#include <linux/types.h>
#include <linux/spi/spidev.h>
#include <stdint.h>
#include <stdio.h>
#include <string.h>

const uint16_t character_patterns[] = {
  0b0000000000000000, /* (space) */
  0b0000100100000001, /* ! */
  0b0001100000000000, /* " */
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  0b0000000000000000, /* (del) */
};

uint16_t pattern(char c) {
    if ((unsigned char)c < 32 || (unsigned char)c > 127)
        return 0;

    return character_patterns[(unsigned char)c - 32];
}

ssize_t display_text(int fd, char* str, size_t n) {
    if (n < 1) return 0;
    size_t i = n-1;
    
    for (ssize_t i = n-1; i >= 0; i--) {
        uint16_t current_char = pattern(str[i]);
        if(write(fd, &current_char, 2) < 0) {
            printf("failed to write test to display\n");
            return -1;
        }
    }
    return n;
}

int main()
{
        printf("Running SPI Test.\n");

        int fd = open("/dev/spidev0.0", O_WRONLY);
        if (fd < 0) {
                printf("cannot open spidev\n");
                return 1;
        }

        unsigned char mode = SPI_MODE_0;
        if (ioctl(fd, SPI_IOC_WR_MODE, &mode) < 0) {
                printf("failed to set spi mode\n");
                close(fd);
                return 1;
        }

        unsigned long max_speed = 10000; // 10 kHz
        if (ioctl(fd, SPI_IOC_WR_MAX_SPEED_HZ, &max_speed) < 0) {
                printf("failed to set spi speed\n");
                close(fd);
                return 1;
        }
        char* text = "- Testinhalt -";
        display_text(fd, text, strlen(text));

        close(fd);
        return 0;
}